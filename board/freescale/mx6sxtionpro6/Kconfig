## board/freescale/mx6sxtionpro6/Kconfig
```kconfig
if TARGET_MX6SXTIONPRO6

config SYS_BOARD
	default "mx6sxtionpro6"

config SYS_VENDOR
	default "freescale"

config SYS_CONFIG_NAME
	default "mx6sxtionpro6"

config MX6SXSABRESD_EMMC_REWORK
	bool "Select for the board with eMMC rework"
	
config SYS_TEXT_BASE
	default 0x87800000
endif
```
